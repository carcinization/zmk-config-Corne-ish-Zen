## config/west.yml
```yaml
manifest:
  remotes:
    - name: zmkfirmware
      url-base: https://github.com/LOWPROKB
    - name: carcinization
      url-base: https://github.com/carcinization

  projects:
    - name: zmk
      remote: carcinization
      revision: corneish-zen
      import: app/west.yml
  self:
    path: config
```
